## firmware/sdkconfig.defaults
```kconfig
# ESP32-S3 Box 3 defaults
CONFIG_IDF_TARGET="esp32s3"

# Flash (Box 3 has 16MB flash)
CONFIG_ESPTOOLPY_FLASHSIZE_16MB=y

# Partition table
CONFIG_PARTITION_TABLE_CUSTOM=y
CONFIG_PARTITION_TABLE_CUSTOM_FILENAME="partitions.csv"

# PSRAM (Box 3 has 16MB PSRAM)
CONFIG_SPIRAM=y
CONFIG_SPIRAM_MODE_OCT=y
CONFIG_SPIRAM_SPEED_80M=y

# LVGL
CONFIG_LV_COLOR_DEPTH_16=y
CONFIG_LV_MEM_CUSTOM=y
CONFIG_LV_FONT_MONTSERRAT_14=y
CONFIG_LV_FONT_MONTSERRAT_16=y
CONFIG_LV_FONT_MONTSERRAT_20=y
CONFIG_LV_FONT_MONTSERRAT_24=y

# WiFi
CONFIG_ESP_WIFI_STATIC_RX_BUFFER_NUM=16
CONFIG_ESP_WIFI_DYNAMIC_RX_BUFFER_NUM=128
CONFIG_ESP_WIFI_DYNAMIC_TX_BUFFER_NUM=128

# HTTP client
CONFIG_ESP_HTTP_CLIENT_ENABLE_HTTPS=y

# SNTP
CONFIG_LWIP_SNTP_MAX_SERVERS=2

# Stack sizes
CONFIG_ESP_MAIN_TASK_STACK_SIZE=8192
CONFIG_PTHREAD_TASK_STACK_SIZE_DEFAULT=4096

# Compiler optimisation
CONFIG_COMPILER_OPTIMIZATION_SIZE=y
```
